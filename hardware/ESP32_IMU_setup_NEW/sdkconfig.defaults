## hardware/ESP32_IMU_setup_NEW/sdkconfig.defaults
```kconfig
# --- FreeRTOS timing (undgår pdMS_TO_TICKS(5) -> 0 ved lav tickrate) ---
CONFIG_FREERTOS_HZ=1000

# --- Flash size (ESP32-S3 board har 8MB flash) ---
ESPTOOLPY_FLASHSIZE_8MB=y

# --- Bluetooth / NimBLE ---
CONFIG_BT_ENABLED=y
CONFIG_BT_CONTROLLER_ENABLED=y
CONFIG_BT_NIMBLE_ENABLED=y

# NimBLE roller
CONFIG_BT_NIMBLE_ROLE_BROADCASTER=y
CONFIG_BT_NIMBLE_ROLE_OBSERVER=y
CONFIG_BT_NIMBLE_ROLE_PERIPHERAL=y
CONFIG_BT_NIMBLE_ROLE_CENTRAL=y

# Security
CONFIG_BT_NIMBLE_SECURITY_ENABLE=y

# Stack size
CONFIG_BT_NIMBLE_HOST_TASK_STACK_SIZE=4096

# BLE throughput / GATT
CONFIG_BT_NIMBLE_ATT_PREFERRED_MTU=247
CONFIG_BT_CTRL_TX_BUFFER_NUM=20
CONFIG_BT_NIMBLE_TRANSPORT_ACL_FROM_LL_COUNT=24
CONFIG_BT_NIMBLE_TRANSPORT_ACL_SIZE=255

# NimBLE log level
# CONFIG_BT_NIMBLE_LOG_LEVEL_INFO is not set
# CONFIG_BT_NIMBLE_LOG_LEVEL_DEBUG is not set
CONFIG_BT_NIMBLE_LOG_LEVEL_WARNING=y


# NimBLE memory pools (mbuf/msys)
CONFIG_BT_NIMBLE_MSYS_1_BLOCK_COUNT=128
CONFIG_BT_NIMBLE_MSYS_1_BLOCK_SIZE=256
CONFIG_BT_NIMBLE_MSYS_2_BLOCK_COUNT=64
CONFIG_BT_NIMBLE_MSYS_2_BLOCK_SIZE=320
```
