## boards/arm/my_board/Kconfig.board
```kconfig
config BOARD_MY_BOARD
    bool "My Custom nRF52840 board"
    select SOC_NRF52840_QIAA if BOARD_MY_BOARD_NRF52840
```

## boards/arm/my_board/Kconfig.defconfig
```kconfig
if BOARD_MY_BOARD

config GPIO
	default y

config SERIAL
	default n

config CONSOLE
	default y

config PRINTK
	default y

config UART_CONSOLE
	default n

config LOG_BACKEND_UART
	default n

config USE_SEGGER_RTT
	default y

config RTT_CONSOLE
	default y

endif
```

## hardware/Blinky_new/boards/arm/my_board/my_board_nrf52840_defconfig
```kconfig
CONFIG_GPIO=y
CONFIG_SERIAL=n
CONFIG_CONSOLE=y
CONFIG_PRINTK=y
CONFIG_UART_CONSOLE=n
CONFIG_LOG_BACKEND_UART=n
CONFIG_USE_SEGGER_RTT=y
CONFIG_RTT_CONSOLE=y
CONFIG_SPI=y
```
